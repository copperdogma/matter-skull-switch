## firmware/main/Kconfig.projbuild
```kconfig
menu "Example Configuration"

    config SHTC3_I2C_SDA_PIN
        int "I2C SDA Pin"
        default 4
        help
            GPIO number for I2C master data

    config SHTC3_I2C_SCL_PIN
        int "I2C SCL Pin"
        default 5
        help
            GPIO number for I2C master clock

    config PIR_DATA_PIN
        int "PIR Data Pin"
        default 7
        help
            Default PIR Data Pin

endmenu

menu "Occupancy Sensor Configuration"
    config PIR_SENSOR_GPIO_NUM
        int "PIR Sensor GPIO Pin Number"
        default 4
        range 0 39
        help
            GPIO pin number where the PIR sensor output is connected.
            Default is 4.
            
    config LED_INDICATOR_GPIO_NUM
        int "LED Indicator GPIO Pin Number"
        default 6
        range 0 48
        help
            GPIO pin number for the LED status indicator.
            Dim when "on", bright blinking when "motion detected".
            Default is 6 (on the same side as the PIR sensor pin).
            
    config PIR_OCCUPIED_TO_UNOCCUPIED_DELAY_SECONDS
        int "PIR Occupied to Unoccupied Delay (seconds)"
        default 10
        range 5 1800
        help
            Time in seconds before the occupancy sensor reports unoccupied after 
            the last motion detection. Industry standard ranges from 30 seconds 
            to 30 minutes (1800 seconds). Default value is 10 seconds for testing.
            For production, 5-15 minutes (300-900 seconds) is typical.
endmenu
```

## firmware/sdkconfig.defaults.esp32c3
```kconfig
# CONFIG_IDF_TARGET="esp32c3"

# ESP32-C3-DevKitC-02 Settings - Commented out to avoid conflicts
# CONFIG_BSP_BUTTONS_NUM=1
# CONFIG_BSP_BUTTON_1_TYPE_GPIO=y
# CONFIG_BSP_BUTTON_1_GPIO=9
# CONFIG_BSP_BUTTON_1_LEVEL=0

# Default sdkconfig for ESP32-C3 target

# Component config
CONFIG_BT_ENABLED=y
CONFIG_BT_CTRL_SCAN_DUPL_TYPE_DATA_DEVICE=y
# CONFIG_BTDM_CTRL_BLE_MAX_CONN=2 # This was flagged as unknown in reconfigure logs, let menuconfig set it.
CONFIG_BT_BTU_TASK_STACK_SIZE=4512
CONFIG_BT_BLE_42_FEATURES_SUPPORTED=y
CONFIG_BT_BLE_50_FEATURES_SUPPORTED=y
CONFIG_BT_ALLOCATION_FROM_SPIRAM_FIRST=n
CONFIG_BT_BLE_DYNAMIC_ENV_MEMORY=y

# Reduce flash usage to accommodate 4MB flash on C3
CONFIG_PARTITION_TABLE_CUSTOM=y
CONFIG_PARTITION_TABLE_CUSTOM_FILENAME="partitions.csv"

# ESP Matter related settings
CONFIG_ENABLE_CHIP_SHELL=y
# CONFIG_ENABLE_CHIP_SHELL_TRACE_LOGGING=n # This was flagged as unknown, let menuconfig handle

# Heap optimization
CONFIG_HEAP_POISONING_DISABLED=y

# RTC memory
CONFIG_HEAP_TLSF_USE_ROM_IMPL=y

# Memory optimization
CONFIG_FREERTOS_UNICORE=y
CONFIG_ESP_SYSTEM_SINGLE_CORE_MODE=y

# Hardware settings specific to ESP32-C3
# CONFIG_SPIRAM=n # Flagged as unknown
# CONFIG_SPIRAM_USE=n # Flagged as unknown

# Wi-Fi Stability
CONFIG_ESP_WIFI_STA_DISCONNECTED_PM_ENABLE=n
CONFIG_ENABLE_WIFI_STATION=n # Attempt to disable STA mode by default before Matter init

# Matter Time Synchronization
# CONFIG_ESP_MATTER_TIME_SYNC_NONE=y # Unknown symbol
# CONFIG_ESP_MATTER_BLE_ONLY_COMMISSIONING=n # Unknown symbol

# LWIP Task Stack
CONFIG_LWIP_TCPIP_TASK_STACK_SIZE=4096

# SNTP Configuration for Time Synchronization - REMOVED DUE TO UNKNOWN KCONFIG WARNINGS
# CONFIG_LWIP_SNTP_ENABLE=y
# CONFIG_LWIP_SNTP_SERVER_DNS=y
# CONFIG_LWIP_SNTP_SERVER_NAME="pool.ntp.org"
# CONFIG_LWIP_DHCP_MAX_NTP_SERVERS=1
# CONFIG_LWIP_DHCP_GET_NTP_SRV=y
# CONFIG_ESP_MATTER_NTP_EVENT_TIMEOUT_MS=30000

# Reduce boot time
CONFIG_BOOTLOADER_LOG_LEVEL_WARN=y
CONFIG_LOG_DEFAULT_LEVEL_WARN=y
```
